/*
 * Copyright (c) 2020 The ZMK Contributors
 *
 * SPDX-License-Identifier: MIT
 */


#include <behaviors.dtsi>
#include <dt-bindings/zmk/bt.h>
#include <dt-bindings/zmk/keys.h>

#define HOST_OS 2
#include "../zmk-nodefree-config/helper.h"
#include <dt-bindings/zmk/ext_power.h>


#include "../zmk-nodefree-config/keypos_def/keypos_50keys.h"
#define KEYS_L LT0 LT1 LT2 LT3 LT4 LT5 LM0 LM1 LM2 LM3 LM4 LM5 LB0 LB1 LB2 LB3 LB4 LB5 
#define KEYS_R RT0 RT1 RT2 RT3 RT4 RT5 RM0 RM1 RM2 RM3 RM4 RM5 RB0 RB1 RB2 RB3 RB4 RB5
#define THUMBS LF0 LF1 LH0 LH1 LH2 LH3 LH4 RF0 RF1 RH0 RH1 RH2 RH3 RH4

#define BASE 0
#define CYRMAIN 1
#define CYRXTRA 2
#define NUM 3
#define NAVI 4
#define SYMBOL 5
#define FUNCTION 6
#define TYPOGRAPHY 7
#define BLUETOOTH 8

ZMK_UNICODE_SINGLE(em_dash,        N2, N0, N1, N4)  // —: U+2014
ZMK_UNICODE_SINGLE(horizontal_bar, N2, N0, N1, N5)  // ―: U+2015
ZMK_UNICODE_SINGLE(ellipsis,       N2, N0, N2, N6)  // …: U+2026
ZMK_UNICODE_SINGLE(pound,          N0, N0, A, N3)  // £: U+00A3
ZMK_UNICODE_SINGLE(euro,           N2, N0, A, C)  // €: U+20AC
ZMK_UNICODE_SINGLE(yen,            N0, N0, A, N5)  // ¥: U+00A5
ZMK_UNICODE_SINGLE(leq,            N2, N2, N6, N4)  // ≤: U+2264
ZMK_UNICODE_SINGLE(geq,            N2, N2, N6, N5)  // ≥: U+2265
ZMK_UNICODE_SINGLE(approx,         N2, N2, N4, N8)  // ≈: U+2248
ZMK_UNICODE_SINGLE(times,          N0, N0, D, N7)  // ×: U+00D7
ZMK_UNICODE_SINGLE(ldquo,          N2, N0, N1, E)  // „: U+201E
ZMK_UNICODE_SINGLE(rdquo,          N2, N0, N1, C)  // “: U+201C
ZMK_UNICODE_SINGLE(laquo,          N0, N0, A, B)  // «: U+00AB
ZMK_UNICODE_SINGLE(raquo,          N0, N0, B, B)  // »: U+00BB
ZMK_UNICODE_SINGLE(bullet,         N2, N5, F, C)  // ◼: U+25FC
ZMK_UNICODE_SINGLE(minidot,        N0, N0, B, N7)  // ·: U+00B7
ZMK_UNICODE_SINGLE(checkmark,      N2, N7, N1, N4)  // ✔: U+2714
ZMK_UNICODE_SINGLE(degree,         N0, N0, B, N0)  // °: U+00B0
ZMK_UNICODE_SINGLE(div,            N0, N0, F, N7)  // ÷: U+00F7
ZMK_UNICODE_SINGLE(neq,            N2, N2, N6, N0)  // ≠: U+2260
ZMK_UNICODE_SINGLE(inverted_question_mark, N0, N0, B, F)  // ¿: U+00BF

/* left-hand HRMs */
ZMK_BEHAVIOR(hml, hold_tap,
    flavor = "balanced";
    tapping-term-ms = <280>;
    quick-tap-ms = <175>;                // repeat on tap-into-hold
    require-prior-idle-ms = <150>;
    bindings = <&kp>, <&kp>;
    hold-trigger-key-positions = <KEYS_R THUMBS>;
    hold-trigger-on-release;             // delay positional check until key-release
)

/* right-hand HRMs */
ZMK_BEHAVIOR(hmr, hold_tap,
    flavor = "balanced";
    tapping-term-ms = <280>;
    quick-tap-ms = <175>;                // repeat on tap-into-hold
    require-prior-idle-ms = <150>;
    bindings = <&kp>, <&kp>;
    hold-trigger-key-positions = <KEYS_L THUMBS>;
    hold-trigger-on-release;             // delay positional check until key-release
)

ZMK_BEHAVIOR(hrm, hold_tap,
    flavor = "balanced";
    tapping-term-ms = <280>;
    quick-tap-ms = <125>;
    bindings = <&kp>, <&kp>;
)

ZMK_BEHAVIOR(mse, hold_tap,
    flavor = "balanced";
    tapping-term-ms = <280>;
    quick-tap-ms = <125>;
    bindings = <&mo_symb_eng>, <&kp>;
)

ZMK_BEHAVIOR(msc, hold_tap,
    flavor = "balanced";
    tapping-term-ms = <280>;
    quick-tap-ms = <125>;
    bindings = <&mo_symb_cyr>, <&kp>;
)

ZMK_BEHAVIOR(mnve, hold_tap,
    flavor = "balanced";
    tapping-term-ms = <280>;
    quick-tap-ms = <125>;
    bindings = <&mo_nav_eng>, <&kp>;
)

ZMK_BEHAVIOR(mnvc, hold_tap,
    flavor = "balanced";
    tapping-term-ms = <280>;
    quick-tap-ms = <125>;
    bindings = <&mo_nav_cyr>, <&kp>;
)

ZMK_BEHAVIOR(mne, hold_tap,
    flavor = "balanced";
    tapping-term-ms = <280>;
    quick-tap-ms = <125>;
    bindings = <&mo_num_eng>, <&dot_shift_eng>;
)
ZMK_BEHAVIOR(mnc, hold_tap,
    flavor = "balanced";
    tapping-term-ms = <280>;
    quick-tap-ms = <125>;
    bindings = <&mo_num_cyr>, <&dot_shift_cyr>;
)

ZMK_BEHAVIOR(mfe, hold_tap,
    flavor = "balanced";
    tapping-term-ms = <280>;
    quick-tap-ms = <125>;
    bindings = <&mo_func_eng>, <&kp>;
)

ZMK_BEHAVIOR(mfc, hold_tap,
    flavor = "balanced";
    tapping-term-ms = <280>;
    quick-tap-ms = <125>;
    bindings = <&mo_func_cyr>, <&kp>;
)

ZMK_BEHAVIOR(mte, hold_tap,
    flavor = "balanced";
    tapping-term-ms = <280>;
    quick-tap-ms = <125>;
    bindings = <&mo_typo_eng>, <&kp>;
)

ZMK_BEHAVIOR(mbc, hold_tap,
    flavor = "balanced";
    tapping-term-ms = <280>;
    quick-tap-ms = <125>;
    bindings = <&mo_blt_cyr>, <&kp>;
)

ZMK_BEHAVIOR(mbe, hold_tap,
    flavor = "balanced";
    tapping-term-ms = <280>;
    quick-tap-ms = <125>;
    bindings = <&mo_blt_eng>, <&kp>;
)

ZMK_BEHAVIOR(mtc, hold_tap,
    flavor = "balanced";
    tapping-term-ms = <280>;
    quick-tap-ms = <125>;
    bindings = <&mo_typo_cyr>, <&kp>;
)

ZMK_BEHAVIOR(altrr, hold_tap,
    flavor = "balanced";
    tapping-term-ms = <280>;
    quick-tap-ms = <175>;
    require-prior-idle-ms = <150>;
    bindings = <&alt_cyr>, <&kp>;
    hold-trigger-key-positions = <KEYS_R THUMBS>;
    hold-trigger-on-release; 
)

ZMK_BEHAVIOR(ctlrr, hold_tap,
    flavor = "balanced";
    tapping-term-ms = <280>;
    quick-tap-ms = <175>;
    require-prior-idle-ms = <150>;
    bindings = <&ctl_cyr>, <&kp>;
    hold-trigger-key-positions = <KEYS_R THUMBS>;
    hold-trigger-on-release; 
)

ZMK_BEHAVIOR(guirr, hold_tap,
    flavor = "balanced";
    tapping-term-ms = <280>;
    quick-tap-ms = <175>;
    require-prior-idle-ms = <150>;
    bindings = <&gui_cyr>, <&kp>;
    hold-trigger-key-positions = <KEYS_R THUMBS>;
    hold-trigger-on-release; 
)

ZMK_BEHAVIOR(mehrr, hold_tap,
    flavor = "balanced";
    tapping-term-ms = <280>;
    quick-tap-ms = <175>;
    require-prior-idle-ms = <150>;
    bindings = <&meh_cyr>, <&kp>;
    hold-trigger-key-positions = <KEYS_R THUMBS>;
    hold-trigger-on-release; 
)

ZMK_BEHAVIOR(hyperrr, hold_tap,
    flavor = "balanced";
    tapping-term-ms = <280>;
    quick-tap-ms = <175>;
    require-prior-idle-ms = <150>;
    bindings = <&hyper_cyr>, <&kp>;
    hold-trigger-key-positions = <KEYS_R THUMBS>;
    hold-trigger-on-release; 
)

ZMK_BEHAVIOR(altrl, hold_tap,
    flavor = "balanced";
    tapping-term-ms = <280>;
    quick-tap-ms = <175>;
    require-prior-idle-ms = <150>;
    bindings = <&alt_cyr>, <&kp>;
    hold-trigger-key-positions = <KEYS_L THUMBS>;
    hold-trigger-on-release; 
)

ZMK_BEHAVIOR(ctlrl, hold_tap,
    flavor = "balanced";
    tapping-term-ms = <280>;
    quick-tap-ms = <175>;
    require-prior-idle-ms = <150>;
    bindings = <&ctl_cyr>, <&kp>;
    hold-trigger-key-positions = <KEYS_L THUMBS>;
    hold-trigger-on-release; 
)

ZMK_BEHAVIOR(guirl, hold_tap,
    flavor = "balanced";
    tapping-term-ms = <280>;
    quick-tap-ms = <175>;
    require-prior-idle-ms = <150>;
    bindings = <&gui_cyr>, <&kp>;
    hold-trigger-key-positions = <KEYS_L THUMBS>;
    hold-trigger-on-release; 
)

ZMK_BEHAVIOR(mehrl, hold_tap,
    flavor = "balanced";
    tapping-term-ms = <280>;
    quick-tap-ms = <175>;
    require-prior-idle-ms = <150>;
    bindings = <&meh_cyr>, <&kp>;
    hold-trigger-key-positions = <KEYS_L THUMBS>;
    hold-trigger-on-release; 
)

ZMK_BEHAVIOR(hyperrl, hold_tap,
    flavor = "balanced";
    tapping-term-ms = <280>;
    quick-tap-ms = <175>;
    require-prior-idle-ms = <150>;
    bindings = <&hyper_cyr>, <&kp>;
    hold-trigger-key-positions = <KEYS_L THUMBS>;
    hold-trigger-on-release; 
)

ZMK_BEHAVIOR(cmdtab, hold_tap,
    flavor = "balanced";
    tapping-term-ms = <280>;
    quick-tap-ms = <125>;
    bindings = <&cmd_tab>, <&kp>;
)

&sk {
    release-after-ms = <7000>;
};

/ {

    macros {
        switch_eng: switch_eng {
            label = "Switch_Eng";
            compatible = "zmk,behavior-macro";
            #binding-cells = <0>;
            wait-ms = <10>;
            bindings 
                = <&to 0>,
                <&macro_tap &kp LA(LC(LG(LS(N8))))>,
                <&macro_tap &kp F14>;
        };
        switch_cyr: switch_cyr {
            label = "Switch_Cyr";
            compatible = "zmk,behavior-macro";
            #binding-cells = <0>;
            wait-ms = <10>;
            bindings 
                = <&to 1>,
                <&macro_tap &kp LA(LC(LG(LS(N9))))>,
                <&macro_tap &kp F15>;
        };

        dot_shift_eng: dot_shift_eng {
            label = "Dot_Shift_Eng";
            compatible = "zmk,behavior-macro";
            #binding-cells = <0>;
            wait-ms = <10>;
            bindings
                = <&macro_tap &kp DOT &kp SPACE &sk LSHIFT>;
        };

        dot_shift_cyr: dot_shift_cyr {
            label = "Dot_Shift_Cyr";
            compatible = "zmk,behavior-macro";
            #binding-cells = <0>;
            wait-ms = <10>;
            bindings
                = <&macro_tap &kp FSLH &kp SPACE &sk LSHIFT>;
        };
                
        mo_symb_eng: mo_symb_eng {
            label = "Mo_Symb_Eng";
            compatible = "zmk,behavior-macro";
            #binding-cells = <0>;
            wait-ms = <10>;
            bindings 
                = <&to 5>,
                <&macro_tap &kp LA(LC(LG(LS(N7))))>,
                <&macro_tap &kp F19>,
                <&macro_pause_for_release>,
                <&to 0>,
                <&macro_tap &kp LA(LC(LG(LS(N8))))>,
                <&macro_tap &kp F14>;
        };

        mo_symb_cyr: mo_symb_cyr {
            label = "Mo_Symb_Cyr";
            compatible = "zmk,behavior-macro";
            #binding-cells = <0>;
            wait-ms = <10>;
            bindings 
                = <&to 5>,
                <&macro_tap &kp LA(LC(LG(LS(N7))))>,
                <&macro_tap &kp F19>,
                <&macro_pause_for_release>,
                <&to 1>,
                <&macro_tap &kp LA(LC(LG(LS(N9))))>,
                <&macro_tap &kp F15>;
        };
        
        mo_num_eng: mo_num_eng {
            label = "Mo_Num_Eng";
            compatible = "zmk,behavior-macro";
            #binding-cells = <0>;
            wait-ms = <10>;
            bindings 
                = <&to 3>,
                <&macro_tap &kp LA(LC(LG(LS(N7))))>,
                <&macro_tap &kp F17>,
                <&macro_pause_for_release>,
                <&to 0>,
                <&macro_tap &kp LA(LC(LG(LS(N8))))>,
                <&macro_tap &kp F14>;
        };

        mo_num_cyr: mo_num_cyr {
            label = "Mo_Num_Cyr";
            compatible = "zmk,behavior-macro";
            #binding-cells = <0>;
            wait-ms = <10>;
            bindings 
                = <&to 3>,
                <&macro_tap &kp LA(LC(LG(LS(N7))))>,
                <&macro_tap &kp F17>,
                <&macro_pause_for_release>,
                <&to 1>,
                <&macro_tap &kp LA(LC(LG(LS(N9))))>,
                <&macro_tap &kp F15>;
        };

        mo_nav_eng: mo_nav_eng {
            label = "Mo_Nav_Eng";
            compatible = "zmk,behavior-macro";
            #binding-cells = <0>;
            wait-ms = <10>;
            bindings 
                = <&to 4>,
                <&macro_tap &kp F16>,
                <&macro_pause_for_release>,
                <&to 0>,
                <&macro_tap &kp F14>;
        };

        mo_nav_cyr: mo_nav_cyr {
            label = "Mo_Nav_Cyr";
            compatible = "zmk,behavior-macro";
            #binding-cells = <0>;
            wait-ms = <10>;
            bindings 
                = <&to 4>,
                <&macro_tap &kp F16>,
                <&macro_pause_for_release>,
                <&to 1>,
                <&macro_tap &kp F15>;
        };

        mo_blt_eng: mo_blt_eng {
            label = "Mo_Blt_Eng";
            compatible = "zmk,behavior-macro";
            #binding-cells = <0>;
            wait-ms = <10>;
            bindings 
                = <&to 4>,
                <&macro_tap &kp F18>,
                <&macro_pause_for_release>,
                <&to 0>,
                <&macro_tap &kp F14>;
        };

        mo_blt_cyr: mo_blt_cyr {
            label = "Mo_Blt_Cyr";
            compatible = "zmk,behavior-macro";
            #binding-cells = <0>;
            wait-ms = <10>;
            bindings 
                = <&to 4>,
                <&macro_tap &kp F18>,
                <&macro_pause_for_release>,
                <&to 1>,
                <&macro_tap &kp F15>;
        };

        mo_func_eng: mo_func_eng {
            label = "Mo_Func_Eng";
            compatible = "zmk,behavior-macro";
            #binding-cells = <0>;
            wait-ms = <10>;
            bindings 
                = <&to 6>,
                <&macro_tap &kp F20>,
                <&macro_pause_for_release>,
                <&to 0>,
                <&macro_tap &kp F14>;
        };

        mo_func_cyr: mo_func_cyr {
            label = "Mo_Func_Cyr";
            compatible = "zmk,behavior-macro";
            #binding-cells = <0>;
            wait-ms = <10>;
            bindings 
                = <&to 6>,
                <&macro_tap &kp LA(LC(LG(LS(N8))))>,
                <&macro_tap &kp F20>,
                <&macro_pause_for_release>,
                <&to 1>,
                <&macro_tap &kp LA(LC(LG(LS(N9))))>,
                <&macro_tap &kp F15>;
        };

        mo_typo_eng: mo_typo_eng {
            label = "Mo_Typo_Eng";
            compatible = "zmk,behavior-macro";
            #binding-cells = <0>;
            wait-ms = <10>;
            bindings 
                = <&to 7>,
                <&macro_tap &kp LA(LC(LG(LS(N7))))>,
                <&macro_tap &kp F21>,
                <&macro_pause_for_release>,
                <&to 0>,
                <&macro_tap &kp LA(LC(LG(LS(N8))))>,
                <&macro_tap &kp F14>;

        };
        mo_typo_cyr: mo_typo_cyr {
            label = "Mo_Typo_Cyr";
            compatible = "zmk,behavior-macro";
            #binding-cells = <0>;
            wait-ms = <10>;
            bindings 
                = <&to 7>,
                <&macro_tap &kp LA(LC(LG(LS(N7))))>,
                <&macro_tap &kp F21>,
                <&macro_pause_for_release>,
                <&to 1>,
                <&macro_tap &kp LA(LC(LG(LS(N9))))>,
                <&macro_tap &kp F15>;
        };

        alt_cyr: alt_cyr {
            label = "Alt_Cyr";
            compatible = "zmk,behavior-macro";
            #binding-cells = <0>;
            wait-ms = <10>;
            bindings 
                = <&to 0>,
                <&macro_press &kp LALT>,
                <&macro_pause_for_release>,
                <&to 1>,
                <&macro_release &kp LALT>;
        };

        gui_cyr: gui_cyr {
            label = "Gui_Cyr";
            compatible = "zmk,behavior-macro";
            #binding-cells = <0>;
            wait-ms = <10>;
            bindings 
                = <&to 0>,
                <&macro_press &kp LGUI>,
                <&macro_pause_for_release>,
                <&to 1>,
                <&macro_release &kp LGUI>;
        };

        ctl_cyr: ctl_cyr {
            label = "Ctl_Cyr";
            compatible = "zmk,behavior-macro";
            #binding-cells = <0>;
            wait-ms = <10>;
            bindings 
                = <&to 0>,
                <&macro_press &kp LCTRL>,
                <&macro_pause_for_release>,
                <&to 1>,
                <&macro_release &kp LCTRL>;
        };

        meh_cyr: meh_cyr {
            label = "Meh_Cyr";
            compatible = "zmk,behavior-macro";
            #binding-cells = <0>;
            wait-ms = <10>;
            bindings 
                = <&to 0>,
                <&macro_press &kp LA(LC(LEFT_SHIFT))>,
                <&macro_pause_for_release>,
                <&to 1>,
                <&macro_release &kp LA(LC(LEFT_SHIFT))>;
        };

        hyper_cyr: hyper_cyr {
            label = "Hyper_Cyr";
            compatible = "zmk,behavior-macro";
            #binding-cells = <0>;
            wait-ms = <10>;
            bindings 
                = <&to 0>,
                <&macro_press &kp LA(LC(LG(LEFT_SHIFT)))>,
                <&macro_pause_for_release>,
                <&to 1>,
                <&macro_release &kp LA(LC(LG(LEFT_SHIFT)))>;
        };

        mod_cyr:mod_cyr {
            label = "Mod_Cyr";
            compatible = "zmk,behavior-macro-one-param";
            #binding-cells = <1>;
            wait-ms = <10>;
            bindings
                = <&to 0>,
                <&macro_param_1to1>,
                <&macro_press &kp MACRO_PLACEHOLDER>,
                <&macro_pause_for_release>,
                <&to 1>,
                <&macro_release &kp MACRO_PLACEHOLDER>;
        };

        punct_cyr: punct_cyr {
            label = "Punct_Cyr";
            compatible = "zmk,behavior-macro-one-param";
            #binding-cells = <1>;
            wait-ms = <10>;
            bindings
                = <&macro_tap &kp LA(LC(LG(LS(N8))))>,
                <&macro_param_1to1>,
                <&kp MACRO_PLACEHOLDER>,                
                <&macro_tap &kp LA(LC(LG(LS(N9))))>;
        };

        cmd_tab: cmd_tab {
            label = "Cmd_Tab";
            compatible = "zmk,behavior-macro";
            #binding-cells = <0>;
            wait-ms = <250>;
            bindings
                = <&macro_tap &sk LG(TAB)>,
                <&macro_pause_for_release>,
                <&macro_tap &kp ESC>;
        };

        acute: acute {
            label = "Acute";
            compatible = "zmk,behavior-macro";
            #binding-cells = <0>;
            bindings 
                = <&macro_tap &kp SEMI &kp SEMI &kp FSLH>;
        };

        grave: grave {
            label = "Grave";
            compatible = "zmk,behavior-macro";
            #binding-cells = <0>;
            bindings 
                = <&macro_tap &kp SEMI &kp SEMI &kp BSLH>;
        };

        circumflex: circumflex {
            label = "Circumflex";
            compatible = "zmk,behavior-macro";
            #binding-cells = <0>;
            bindings 
                = <&macro_tap &kp SEMI &kp SEMI &kp CARET>;
        };

        diaeresis: diaeresis {
            label = "Diaeresis";
            compatible = "zmk,behavior-macro";
            #binding-cells = <0>;
            bindings 
                = <&macro_tap &kp SEMI &kp SEMI &kp COLON>;
        };

        tilde: tilde {
            label = "Tilde";
            compatible = "zmk,behavior-macro";
            #binding-cells = <0>;
            bindings 
                = <&macro_tap &kp SEMI &kp SEMI &kp TILDE>;
        };

        angstrom: angstrom {
            label = "Angstrom";
            compatible = "zmk,behavior-macro";
            #binding-cells = <0>;
            bindings 
                = <&macro_tap &kp SEMI &kp SEMI &kp N0>;
        };

        cedilla: cedilla {
            label = "Cedilla";
            compatible = "zmk,behavior-macro";
            #binding-cells = <0>;
            bindings 
                = <&macro_tap &kp SEMI &kp SEMI &kp PIPE>;
        };

        ligature: ligature {
            label = "Ligature";
            compatible = "zmk,behavior-macro";
            #binding-cells = <0>;
            bindings 
                = <&macro_tap &kp SEMI &kp SEMI &kp EQUAL>;
        };

        stroke: stroke {
            label = "Stroke";
            compatible = "zmk,behavior-macro";
            #binding-cells = <0>;
            bindings 
                = <&macro_tap &kp SEMI &kp SEMI &kp MINUS>;
        };

        breve: breve {
            label = "Breve";
            compatible = "zmk,behavior-macro";
            #binding-cells = <0>;
            bindings 
                = <&macro_tap &kp SEMI &kp SEMI &kp RPAR>;
        };


        };

    combos {
        compatible = "zmk,combos";

        combo_switch_eng {
            key-positions = <44 45>;
            bindings = <&switch_eng>;
            layers = <1 2>;
            require-prior-idle-ms = <150>;
        };

        combo_switch_cyr {
            key-positions = <44 45>;
            bindings = <&switch_cyr>;
            layers = <0 3 4 5 6 7 8>;
            require-prior-idle-ms = <150>;
        };

        combo_lang_sync {
            bindings = <&kp LG(SPACE)>;
            key-positions = <4 5>;
            layers = <0 1 2>;
            require-prior-idle-ms = <150>;
        };

        combo_moom {
            key-positions = <32 45>;
            bindings = <&kp LC(SPACE)>;
            require-prior-idle-ms = <150>;
        };

        combo_alfred {
            bindings = <&kp LA(SPACE)>;
            key-positions = <31 44>;
        };

        combo_capsword {
            key-positions = <31 32>;
            bindings = <&caps_word>;
            layers = <0 1 2>;
            require-prior-idle-ms = <150>;
        };

        combo_undo {
            bindings = <&kp LG(Z)>;
            key-positions = <6 18>;
        };

        combo_redo {
            bindings = <&kp LG(Y)>;
            key-positions = <18 34>;
        };

        combo_caps {
            bindings = <&kp CAPS>;
            key-positions = <11 23>;
        };

        combo_selective_paste {
            bindings = <&kp LC(LG(V))>;
            key-positions = <42 43>;
        };

        combo_bt_sel0 {
            key-positions = <1 13>;
            bindings = <&bt BT_SEL 0>;
            layers = <8>;
            require-prior-idle-ms = <150>;
        };

        combo_bt_sel1 {
            key-positions = <2 14>;
            bindings = <&bt BT_SEL 1>;
            layers = <8>;
            require-prior-idle-ms = <150>;
        };

        combo_bt_sel2 {
            key-positions = <3 15>;
            bindings = <&bt BT_SEL 2>;
            layers = <8>;
            require-prior-idle-ms = <150>;
        };

        combo_bt_sel3 {
            key-positions = <4 16>;
            bindings = <&bt BT_SEL 3>;
            layers = <8>;
            require-prior-idle-ms = <150>;
        };

        combo_bt_sel4 {
            key-positions = <5 17>;
            bindings = <&bt BT_SEL 4>;
            layers = <8>;
            require-prior-idle-ms = <150>;
        };

        combo_bt_clr {
            key-positions = <12 24>;
            bindings = <&bt BT_CLR>;
            layers = <8>;
            require-prior-idle-ms = <150>;
        };
    };

        keymap {
        compatible = "zmk,keymap";

            _base {
            bindings = <
            // top line
            &mt LA(LC(LG(LEFT_SHIFT))) ESCAPE &kp Q &kp W &kp F &kp P &kp B  /* middle */ &kp J &kp L &kp U &kp Y &kp APOS &cmdtab 0 MINUS
            // second line
            &mt LA(LC(LEFT_SHIFT)) TAB &hml LCTRL A &hml LALT R &hml LGUI S &hml LSHIFT T &kp G /* middle */ &kp M &hmr RSHIFT N &hmr RGUI E &hmr RALT I &hmr RCTRL O &kp SEMI
            // bottom main line
            &kp TILDE &kp Z  &kp X &kp C &kp D &kp V /* thumb cluster -> */ &mt LA(LC(LEFT_SHIFT)) SPACE &kp LSHFT /* middle */ &kp BSPC &kp DEL /* <- thumb cluster */ &kp K &kp H &kp COMMA &kp DOT &kp FSLH &mbe 0 QUESTION
            // bottom thumb cluster line
            &kp LEFT &kp RIGHT &mte 0 LG(V) &mse 0 LG(C) &mne 0 0  /* middle */ &kp ENTER &mnve 0 LPAR &mfe 0 RPAR &kp DOWN &kp UP
            >;
        };

        _cyr_main {
            bindings = <
            // top line 
            &hyperrl 0 ESCAPE &kp Q &kp W &kp E &kp R &kp T /* middle */ &kp Y &kp U &kp I &kp O &punct_cyr APOS &cmdtab 0 MINUS
            // second line
            &mehrl 0 TAB &ctlrl 0 A &altrl 0 S &guirl 0 D &hml LSHIFT F &lt 2 G /* middle */ &lt 2 H &hmr RSHIFT J &guirr 0 K &altrr 0 L &ctlrr 0 SEMI &punct_cyr SEMI
            // bottom main line
            &punct_cyr TILDE &kp Z &kp X &kp C &kp V &kp B /* top thumb cluster line -> */ &mehrl 0 SPACE &trans /* middle */ &trans &trans /* <- top thumb cluster line */ &kp N &kp M &punct_cyr COMMA &punct_cyr DOT &punct_cyr FSLH &mbc 0 LS(N7) 
            // bottom thumb cluster line
            &trans &trans &mtc 0 LG(V) &msc 0 LG(C) &mnc 0 0 /* middle */ &trans &mnvc 0 LPAR &mfc 0 RPAR &trans &trans           
            >;
        };

        _cyr_xtra {
            bindings = <
            // top line 
            &trans &kp GRAVE &trans &trans &trans &trans /* middle */ &trans &trans &trans &trans &kp P &kp LBKT
            // second line
            &trans &trans &trans &trans &trans &trans /* middle */ &trans &trans &trans &trans &trans &kp APOS
            // bottom main line
            &trans &trans &trans &trans &trans &trans /* top thumb cluster line -> */ &trans &trans /* middle */ &trans &trans /* <- top thumb cluster line */ &trans &kp RBKT &kp COMMA &kp DOT &trans &trans 
            // bottom thumb cluster line
            &trans &trans &trans &trans &trans /* middle */ &trans &trans &trans &trans &trans  
            >;
        };

        _num {
            bindings = <
            // top line 
            &times &kp MINUS &kp N7 &kp N8 &kp N9 &kp PLUS /* middle */ &kp LPAR &kp RPAR &kp LT &kp GT &kp APOS &kp MINUS
            // second line
            &div &kp ASTERISK &kp N4 &kp N5 &kp N6 &kp FSLH  /* middle */ &kp LBKT &kp RBKT &leq &geq &kp UNDER &kp SEMI
            // bottom main line
            &neq &kp EQUAL &kp N1 &kp N2 &kp N3 &kp N0 /* top thumb cluster line -> */ &trans &trans /* middle */ &trans &trans /* <- top thumb cluster line */ &kp LBRC &kp RBRC &kp COMMA &kp DOT &kp BSLH &kp QUESTION 
            // bottom thumb cluster line
            &trans &trans &trans &trans &trans /* middle */ &trans &trans &trans &trans &trans  
            >;
        };

        _navi {
            bindings = <
            // top line 
            &kp LA(LC(LS(N2))) &kp LA(LC(LS(N3))) &kp LA(LC(LG(LS(LEFT))))  &kp LA(LC(LG(LS(RIGHT)))) &kp LA(LSHIFT) &kp LALT /* middle */ &kp LEFT &kp RIGHT &kp DOWN &kp UP &kp LA(LC(LS(N2))) &kp LA(LC(LS(N3)))
            // second line
            &kp LA(LC(LS(N1))) &kp LA(LC(LS(N4))) &kp LA(LC(LG(LS(DOWN))))  &kp LA(LC(LG(LS(UP)))) &kp LS(LGUI) &kp LGUI /* middle */ &kp PAGE_DOWN &kp PAGE_UP &kp END &kp HOME &kp LA(LC(LS(N1))) &kp LA(LC(LS(N4)))
            // bottom main line
            &kp LA(LC(LS(N9))) &trans &trans &trans &kp LG(PLUS) &kp LG(MINUS) /* top thumb cluster line -> */ &trans &trans /* middle */ &trans &trans /* <- top thumb cluster line */ &kp LA(LEFT) &kp LA(RIGHT) &kp LA(DOWN) &kp LA(UP) &trans &kp LA(LC(LS(N9))) 
            // bottom thumb cluster line
            &trans &trans &trans &trans &trans /* middle */ &trans &trans &trans &trans &trans  
            >;
        };

        _symbol {
            bindings = <
            // top line 
            &ellipsis &euro &kp AMPERSAND &kp KP_MULTIPLY &kp PLUS &kp EQUAL  /* middle */ &ldquo &rdquo &kp DQT &checkmark &kp BSLH &em_dash
            // second line 
            &kp GRAVE &yen &kp DOLLAR &kp PERCENT &kp CARET &approx /* middle */ &laquo &raquo &minidot &degree &kp FSLH &horizontal_bar
            // bottom main line
            &kp TILDE &pound &kp EXCL &kp AT &kp POUND &neq /* top thumb cluster line -> */ &trans &trans /* middle */ &trans &trans /* <- top thumb cluster line */ &leq &geq &inverted_question_mark &bullet &kp PIPE &kp UNDER 
            // bottom thumb cluster line
            &trans &trans &trans &trans &trans /* middle */ &trans &trans &trans &trans &trans  
            >;
        };

        _function {
            bindings = <
            // top line 
            &kp LG(L) &kp F12 &kp F7 &kp F8 &kp F9 &kp LG(S) /* middle */ &kp LG(C) &kp LG(V) &kp LG(X) &kp K_MUTE &kp C_VOL_UP &kp C_VOL_DN
            // second line
            &trans &kp F11 &kp F4 &kp F5 &kp F6 &kp LG(T) /* middle */ &kp LG(Z) &kp LG(Y) &trans &kp C_PLAY_PAUSE &kp C_PREVIOUS &kp C_NEXT
            // bottom main line
            &kp LG(COMMA) &kp F10 &kp F1 &kp F2 &kp F3 &kp LG(N) /* top thumb cluster line -> */ &trans &trans /* middle */ &trans &trans /* <- top thumb cluster line */ &kp LG(W) &kp LG(Q) &trans &trans &kp C_BRI_UP &kp C_BRI_DN 
            // bottom thumb cluster line
            &trans &trans &trans &trans &trans /* middle */ &trans &trans &trans &trans &trans  
            >;
        };

        _typography {
            bindings = <
            // top line 
            &ext_power EP_ON &trans &breve &acute &grave &circumflex /* middle */ &trans &trans &trans &trans &trans &trans
            // second line
            &ext_power EP_OFF &trans &trans &diaeresis &tilde &angstrom /* middle */ &trans &kp RSHIFT &trans &trans &trans &trans
            // bottom main line
            &trans &trans &trans &cedilla &ligature &stroke /* top thumb cluster line -> */ &trans &trans /* middle */ &trans &trans /* <- top thumb cluster line */ &trans &trans &trans &trans &trans &trans 
            // bottom thumb cluster line
            &trans &trans &trans &trans &trans /* middle */ &trans &trans &trans &trans &trans  
            >;
        };
        _bluetooth {
            bindings = <
            // top line 
            &trans &trans &trans &trans &trans &trans /* middle */ &trans &trans &trans &trans &trans &trans
            // second line
            &trans &trans &trans &trans &trans &trans /* middle */ &trans &trans &trans &trans &trans &trans
            // bottom main line
            &trans &trans &trans &trans &trans &trans /* top thumb cluster line -> */ &trans &trans /* middle */ &trans &trans /* <- top thumb cluster line */ &trans &trans &trans &trans &trans &trans 
            // bottom thumb cluster line
            &trans &trans &trans &trans &trans /* middle */ &trans &trans &trans &trans &trans  
            >;
        };

        };
    };
